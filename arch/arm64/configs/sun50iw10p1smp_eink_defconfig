## arch/arm64/configs/sun50iw10p1smp_eink_defconfig
```kconfig
# CONFIG_LOCALVERSION_AUTO is not set
CONFIG_SYSVIPC=y
CONFIG_USELIB=y
CONFIG_NO_HZ=y
CONFIG_HIGH_RES_TIMERS=y
CONFIG_PREEMPT=y
CONFIG_BSD_PROCESS_ACCT=y
CONFIG_BSD_PROCESS_ACCT_V3=y
CONFIG_IKCONFIG=y
CONFIG_IKCONFIG_PROC=y
CONFIG_PRINTK_SAFE_LOG_BUF_SHIFT=17
CONFIG_CGROUPS=y
CONFIG_CGROUP_SCHED=y
CONFIG_NAMESPACES=y
# CONFIG_UTS_NS is not set
# CONFIG_PID_NS is not set
CONFIG_BLK_DEV_INITRD=y
CONFIG_INITRAMFS_SOURCE="./rootfs.cpio.gz"
# CONFIG_RD_BZIP2 is not set
# CONFIG_RD_LZMA is not set
# CONFIG_RD_XZ is not set
# CONFIG_RD_LZO is not set
# CONFIG_RD_LZ4 is not set
# CONFIG_SYSFS_SYSCALL is not set
# CONFIG_FHANDLE is not set
CONFIG_KALLSYMS_ALL=y
# CONFIG_RSEQ is not set
CONFIG_EMBEDDED=y
# CONFIG_COMPAT_BRK is not set
# CONFIG_SLAB_MERGE_DEFAULT is not set
CONFIG_PROFILING=y
CONFIG_ARCH_SUNXI=y
CONFIG_EVB_PLATFORM=y
CONFIG_SUNXI_SOC_NAME="sun50iw10"
CONFIG_SCHED_MC=y
CONFIG_NR_CPUS=4
CONFIG_KEXEC=y
CONFIG_CRASH_DUMP=y
CONFIG_COMPAT=y
# CONFIG_EFI is not set
CONFIG_PM_WAKELOCKS=y
CONFIG_PM_DEBUG=y
CONFIG_PM_ADVANCED_DEBUG=y
CONFIG_CPU_IDLE=y
CONFIG_ARM_PSCI_CPUIDLE=y
CONFIG_CPU_FREQ=y
CONFIG_CPU_FREQ_STAT=y
CONFIG_CPU_FREQ_TIMES=y
CONFIG_CPU_FREQ_GOV_POWERSAVE=y
CONFIG_CPU_FREQ_GOV_USERSPACE=y
CONFIG_CPU_FREQ_GOV_ONDEMAND=y
CONFIG_CPU_FREQ_GOV_CONSERVATIVE=y
CONFIG_CPU_FREQ_GOV_SCHEDUTIL=y
CONFIG_CPUFREQ_DT=y
CONFIG_ARM_ALLWINNER_SUN50I_CPUFREQ_NVMEM=y
CONFIG_ARM64_CRYPTO=y
CONFIG_CRYPTO_SHA2_ARM64_CE=y
CONFIG_CRYPTO_AES_ARM64_CE_BLK=y
CONFIG_MODULES=y
CONFIG_MODULE_UNLOAD=y
# CONFIG_CORE_DUMP_DEFAULT_ELF_HEADERS is not set
CONFIG_CMA=y
CONFIG_CMA_AREAS=16
CONFIG_NET=y
CONFIG_UNIX=y
CONFIG_UNIX_DIAG=y
CONFIG_INET=y
CONFIG_PCI=y
# CONFIG_PCI_QUIRKS is not set
CONFIG_DEVTMPFS=y
# CONFIG_ALLOW_DEV_COREDUMP is not set
# CONFIG_SUN50I_DE2_BUS is not set
# CONFIG_SUNXI_RSB is not set
CONFIG_SUNXI_NSI=y
CONFIG_SCSI=y
CONFIG_BLK_DEV_SD=y
CONFIG_INPUT_EVDEV=y
CONFIG_KEYBOARD_SUNXI=y
# CONFIG_INPUT_MOUSE is not set
CONFIG_INPUT_MISC=y
CONFIG_INPUT_AXP2101_PEK=y
# CONFIG_SERIO_SERPORT is not set
# CONFIG_VT is not set
CONFIG_LEGACY_PTY_COUNT=16
# CONFIG_HW_RANDOM is not set
# CONFIG_DEVPORT is not set
CONFIG_SUNXI_SYS_INFO=y
CONFIG_SUNXI_SMC=y
CONFIG_I2C=y
# CONFIG_I2C_COMPAT is not set
CONFIG_I2C_CHARDEV=y
CONFIG_I2C_MUX=y
# CONFIG_I2C_HELPER_AUTO is not set
CONFIG_I2C_SUNXI=y
# CONFIG_PINCTRL_SUN8I_H3_R is not set
# CONFIG_PINCTRL_SUN50I_A64 is not set
# CONFIG_PINCTRL_SUN50I_A64_R is not set
# CONFIG_PINCTRL_SUN50I_A100 is not set
# CONFIG_PINCTRL_SUN50I_A100_R is not set
# CONFIG_PINCTRL_SUN50I_H5 is not set
# CONFIG_PINCTRL_SUN50I_H6 is not set
# CONFIG_PINCTRL_SUN50I_H6_R is not set
CONFIG_GPIO_SUNXI=y
CONFIG_GPIO_GENERIC_PLATFORM=y
CONFIG_AXP803_POWER=y
CONFIG_AXP2202_POWER=y
CONFIG_THERMAL=y
CONFIG_THERMAL_STATISTICS=y
CONFIG_THERMAL_GOV_USER_SPACE=y
CONFIG_THERMAL_GOV_POWER_ALLOCATOR=y
CONFIG_CPU_THERMAL=y
CONFIG_DEVFREQ_THERMAL=y
CONFIG_THERMAL_EMULATION=y
CONFIG_SUNXI_THERMAL=y
CONFIG_MFD_AXP2101_I2C=y
CONFIG_MFD_SYSCON=y
CONFIG_REGULATOR=y
CONFIG_REGULATOR_FIXED_VOLTAGE=y
CONFIG_REGULATOR_VIRTUAL_CONSUMER=y
CONFIG_REGULATOR_AXP2101=y
# CONFIG_VGA_ARB is not set
CONFIG_FB=y
CONFIG_DISP2_SUNXI=y
CONFIG_BACKLIGHT_CLASS_DEVICE=y
CONFIG_SOUND=y
CONFIG_SND=y
CONFIG_SND_SOC=y
CONFIG_USB=y
CONFIG_USB_EHCI_HCD=y
CONFIG_USB_EHCI_HCD_SUNXI=y
CONFIG_USB_OHCI_HCD=y
CONFIG_USB_OHCI_HCD_SUNXI=y
CONFIG_USB_SUNXI_HCD=y
CONFIG_USB_SUNXI_HCI=y
CONFIG_USB_SUNXI_EHCI0=y
CONFIG_USB_SUNXI_EHCI1=y
CONFIG_USB_SUNXI_OHCI0=y
CONFIG_USB_SUNXI_OHCI1=y
CONFIG_USB_STORAGE=y
CONFIG_USB_STORAGE_REALTEK=y
CONFIG_USB_STORAGE_DATAFAB=y
CONFIG_USB_STORAGE_FREECOM=y
CONFIG_USB_STORAGE_ISD200=y
CONFIG_USB_STORAGE_USBAT=y
CONFIG_USB_STORAGE_SDDR09=y
CONFIG_USB_STORAGE_SDDR55=y
CONFIG_USB_STORAGE_JUMPSHOT=y
CONFIG_USB_STORAGE_ALAUDA=y
CONFIG_USB_STORAGE_ONETOUCH=y
CONFIG_USB_STORAGE_KARMA=y
CONFIG_USB_STORAGE_CYPRESS_ATACB=y
CONFIG_USB_STORAGE_ENE_UB6250=y
CONFIG_USB_UAS=y
CONFIG_USB_GADGET=y
CONFIG_USB_SUNXI_UDC0=y
CONFIG_USB_CONFIGFS=y
CONFIG_USB_CONFIGFS_UEVENT=y
CONFIG_USB_CONFIGFS_MASS_STORAGE=y
CONFIG_USB_CONFIGFS_F_FS=y
CONFIG_USB_SUNXI_USB=y
CONFIG_USB_SUNXI_USB_MANAGER=y
CONFIG_USB_SUNXI_USB_DEBUG=y
CONFIG_USB_SUNXI_USB_ADB=y
CONFIG_TYPEC=y
CONFIG_TYPEC_TCPM=y
CONFIG_TYPEC_UCSI=y
CONFIG_MMC=y
# CONFIG_PWRSEQ_EMMC is not set
# CONFIG_PWRSEQ_SIMPLE is not set
CONFIG_MMC_SUNXI=y
# CONFIG_MMC_SUNXI_V4P10X is not set
CONFIG_RTC_CLASS=y
CONFIG_RTC_DRV_SUNXI=y
CONFIG_SUNXI_RTC_POWEROFF_ALARM=y
CONFIG_DMADEVICES=y
CONFIG_DMA_SUN6I=y
CONFIG_SYNC_FILE=y
CONFIG_SW_SYNC=y
CONFIG_STAGING=y
CONFIG_ION=y
CONFIG_ION_SYSTEM_HEAP=y
CONFIG_ION_CMA_HEAP=y
# CONFIG_CLK_SUNXI is not set
# CONFIG_SUN50I_A64_CCU is not set
# CONFIG_SUN50I_A100_CCU is not set
# CONFIG_SUN50I_A100_R_CCU is not set
# CONFIG_SUN50I_H6_CCU is not set
# CONFIG_SUN50I_H6_R_CCU is not set
# CONFIG_SUN8I_H3_CCU is not set
# CONFIG_SUN8I_DE2_CCU is not set
# CONFIG_SUN8I_R_CCU is not set
CONFIG_SUN4I_TIMER=y
# CONFIG_ARM_ARCH_TIMER_EVTSTREAM is not set
# CONFIG_FSL_ERRATUM_A008585 is not set
CONFIG_SUNXI_IOMMU=y
CONFIG_SUNXI_SID=y
CONFIG_SUNXI_DUMP=y
CONFIG_PM_DEVFREQ=y
CONFIG_PWM=y
CONFIG_PWM_SUNXI_GROUP=y
CONFIG_SUNXI_WAKEUPGEN=y
CONFIG_SUN8I_NMI=y
CONFIG_ANDROID=y
CONFIG_NVMEM_SUNXI_SID=y
CONFIG_EXT4_FS=y
# CONFIG_DNOTIFY is not set
CONFIG_MSDOS_FS=y
CONFIG_VFAT_FS=y
CONFIG_TMPFS=y
CONFIG_TMPFS_POSIX_ACL=y
# CONFIG_MISC_FILESYSTEMS is not set
CONFIG_NLS_CODEPAGE_437=y
CONFIG_NLS_ISO8859_1=y
CONFIG_HARDENED_USERCOPY=y
CONFIG_CRYPTO_USER_API_HASH=y
CONFIG_CRYPTO_USER_API_SKCIPHER=y
CONFIG_CRYPTO_USER_API_RNG=y
CONFIG_CRYPTO_USER_API_AEAD=y
CONFIG_CRYPTO_DEV_SUNXI=y
CONFIG_XZ_DEC=y
CONFIG_DMA_CMA=y
CONFIG_PRINTK_TIME=y
CONFIG_MESSAGE_LOGLEVEL_DEFAULT=7
CONFIG_DYNAMIC_DEBUG=y
CONFIG_DEBUG_INFO=y
CONFIG_DEBUG_FS=y
# CONFIG_SECTION_MISMATCH_WARN_ONLY is not set
CONFIG_MAGIC_SYSRQ=y
CONFIG_SLUB_DEBUG_ON=y
CONFIG_DEBUG_VM=y
CONFIG_PANIC_ON_OOPS=y
# CONFIG_SCHED_DEBUG is not set
# CONFIG_DEBUG_PREEMPT is not set
CONFIG_DEBUG_MUTEXES=y
CONFIG_STACKTRACE=y
# CONFIG_FTRACE is not set
CONFIG_ATOMIC64_SELFTEST=y
```

## drivers/car_reverse/Kconfig
```kconfig
#
# SPDX-License-Identifier: GPL-2.0-only
#
# SUNXI CAR REVERSE DRIVER
#
menu "Sunxi Car Reverse Drivers"

config SUNXI_CAR_REVERSE
	tristate "sunxi car reverse driver"
	default n


config SUNXI_CAR_REVERSE_AMP
	tristate "sunxi fast car reverse driver for amp"
	depends on SUNXI_CAR_REVERSE
	default n

endmenu
```

## drivers/char/sunxi-di/Kconfig
```kconfig
menuconfig SUNXI_DI
	tristate "Allwinnertech DE-Interlace Driver"
	default n
	help
	  This is an option for de-interlace.

config SUNXI_DI_V1XX
  bool "Support DI V110/120"
  depends on (SUNXI_DI)
  default n
  ---help---
  Say Y here if you want to use DI110/120.
  Say N here if you do NOT want to use DI110/120.
  If unsure, say N.

config SUNXI_DI_V2X
  bool "Support DI V200"
  depends on (SUNXI_DI)
  default n
  ---help---
  Say Y here if you want to use DI200.
  Say N here if you do NOT want to use DI200.
  If unsure, say N.

config SUNXI_DI_V3X
  bool "Support DI V300"
  depends on (SUNXI_DI)
  default n
  ---help---
  Say Y here if you want to use DI300.
  Say N here if you do NOT want to use DI300.
  If unsure, say N.

config SUNXI_DI_SINGEL_FILE
  bool "Support Single File"
  depends on (SUNXI_DI_V3X)
  default n
  ---help---
  Say Y here if you want to use Single File.
  Say N here if you do NOT want to use Single File.
  If unsure, say N.

config SUNXI_DI_AMP_SERVER
  bool "Open amp server"
  depends on (SUNXI_DI)
  select RPMSG
  default n
  ---help---
  Say Y here if you want to open amp server in DI.
  Say N here if you do NOT want to open amp server in DI.
  If unsure, say N.
```

## drivers/media/platform/sunxi-tvd/Kconfig
```kconfig
# SPDX-License-Identifier: GPL-2.0
menu "TVD_Drivers"

config SUNXI_TVD_AMP_SERVER
	bool "Open amp server"
	default n
	help
	 Say Y here if you want to open amp server in TVD.
	 Say N here if you do NOT want to open amp server in TVD.
	 If unsure, say N.

endmenu
```

## drivers/media/platform/sunxi-vin/modules/sensor/Kconfig
```kconfig
config SENSOR_RN6854M
	tristate "use rn6854m driver"
	default n

config SENSOR_NVP6158C
	tristate "use nvp6158c driver"
	default n

config SENSOR_GC05A2
	tristate "use gc05A2 driver"
	default n

config SENSOR_GC030A
	tristate "use gc030a driver"
	default n

config SENSOR_GC2385
	tristate "use gc2385 driver"
	default n

config SENSOR_GC5025
	tristate "use gc5025 driver"
	default n

config SENSOR_IMX278
	tristate "use imx278 driver"
	default n

config SENSOR_IMX278_2LANE
	tristate "use imx278_2lane driver"
	default n

config SENSOR_IMX386
	tristate "use imx386 driver"
	default n

config SENSOR_IMX386_2LANE
	tristate "use imx386_2lane driver"
	default n

config SENSOR_OV5640
	tristate "use ov5640 driver"
	default n

config SENSOR_OV2775
	tristate "use ov2775 driver"
	default n

config SENSOR_GC2145
	tristate "use gc2145 driver"
	default n

config SENSOR_GC0310
	tristate "use gc0310 driver"
	default n

config SENSOR_GC2355
	tristate "use gc2355 driver"
	default n

config SENSOR_GC5024
	tristate "use gc5024 driver"
	default n

config SENSOR_GC5035
	tristate "use gc5035 driver"
	default n

config SENSOR_GC2590
	tristate "use gc2590 driver"
	default n

config SENSOR_SP5409
	tristate "use sp5409 driver"
	default n

config SENSOR_IMX214
	tristate "use imx214 driver"
	default n

config SENSOR_IMX219
	tristate "use imx219 driver"
	default n

config SENSOR_IMX274_SLVDS
	tristate "use imx274_slvds driver"
	default n

config SENSOR_IMX291_DVP
	tristate "use imx291_dvp driver"
	default n

config SENSOR_IMX291
	tristate "use imx291 driver"
	default n

config SENSOR_IMX317
	tristate "use imx317 driver"
	default n

config SENSOR_IMX335
	tristate "use imx335 driver"
	default n

config SENSOR_IMX326
	tristate "use imx326 driver"
	default n

config SENSOR_IMX477
	tristate "use imx477 driver"
	default n

config SENSOR_OV2710
	tristate "use ov2710 driver"
	default n

config SENSOR_OV2718
	tristate "use ov2718 driver"
	default n

config SENSOR_AR0238
	tristate "use ar0238 driver"
	default n

config SENSOR_OV8858_R2A_4LANE
	tristate "use ov8858_r2a_4lane driver"
	default n

config SENSOR_OV2680
	tristate "use ov2680 driver"
	default n

config SENSOR_S5K3H5XA
	tristate "use s5k3h5xa driver"
	default n

config SENSOR_AR0238_HISPI
	tristate "use ar0238_hispi driver"
	default n

config SENSOR_NVP6134
	tristate "use nvp6134 driver"
	default n

config SENSOR_NVP6324
	tristate "use nvp6324 driver"
	default n

config SENSOR_TP9950
	tristate "use tp9950 driver"
	default n

config SENSOR_SC2232
	tristate "use sc2232 driver"
	default n

config SENSOR_GC02M2
	tristate "use gc02m2 driver"
	default n

config SENSOR_N5_DVP
	tristate "use n5_dvp driver"
	default n
```

## drivers/misc/gpio-motor/Kconfig
```kconfig
# SPDX-License-Identifier: GPL-2.0-only
menu "GPIO Motor support"

config MOTOR_CONTROL
	tristate "Motor Control Driver"
	depends on OF_GPIO
	help
	  Motor Control Driver

config MOTOR_LIMITER
	tristate "Motor Limiter Driver"
	depends on OF_GPIO
	help
	  Motor Limiter Driver

endmenu
```

## drivers/net/ethernet/allwinner/sunxi-gmac-ng/Kconfig
```kconfig
# SPDX-License-Identifier: GPL-2.0-only
#
# Allwinner device configuration
#

config SUNXI_GMAC_NG
	tristate "Allwinner GMAC NG support"
	depends on OF && !SUNXI_GMAC
	select SUNXI_GMAC_MDIO_NG
	select CRC32
	help
	  Support for Allwinner Gigabit ethernet driver.

	  To compile this driver as a module, choose M here.  The module
	  will be called sunxi-gmac.ko.

config SUNXI_GMAC_MDIO_NG
	tristate "Allwinner GMAC MDIO NG support"
	depends on !SUNXI_GMAC
	select MDIO_BUS
	select MDIO_DEVICE
	select PHYLIB
	select MII
	help
	  This driver supports the GMAC MDIO interface in the network

config SUNXI_GMAC_NG_METADATA
	bool "Allwinner GMAC NG metadata support"
	depends on SUNXI_GMAC_NG
	help
	  Support Allwinner GMAC to transmit and receive metadata
```

## drivers/npu/Kconfig
```kconfig
source "drivers/npu/aw_nna_vip/Kconfig"
source "drivers/npu/aw_nna_galcore/Kconfig"
```

## drivers/npu/aw_nna_galcore/Kconfig
```kconfig
config AW_NNA_GALCORE
	depends on (ARCH_SUNXI)
	tristate "aw nna galcore driver"
	default n
	help
	 Choose Y to enable aw nna galcore driver
```

## drivers/npu/aw_nna_vip/Kconfig
```kconfig
config AW_NNA_VIP
	depends on (ARCH_SUNXI)
	tristate "aw nna vip driver"
	default n
	select DMA_SHARED_BUFFER
	help
	 Choose Y to enable aw nna vip driver
```

## drivers/rpmsg/Kconfig
```kconfig
# SPDX-License-Identifier: GPL-2.0

menu "Rpmsg drivers"

# RPMSG always gets selected by whoever wants it
config RPMSG
	tristate

config RPMSG_CHAR
	tristate "RPMSG device interface"
	depends on RPMSG
	depends on NET
	help
	  Say Y here to export rpmsg endpoints as device files, usually found
	  in /dev. They make it possible for user-space programs to send and
	  receive rpmsg packets.

config RPMSG_QCOM_GLINK_NATIVE
	tristate
	select RPMSG

config RPMSG_QCOM_GLINK_RPM
	tristate "Qualcomm RPM Glink driver"
        select RPMSG_QCOM_GLINK_NATIVE
	depends on HAS_IOMEM
	depends on MAILBOX
	help
	  Say y here to enable support for the GLINK RPM communication driver,
	  which serves as a channel for communication with the RPM in GLINK
	  enabled systems.

config RPMSG_SUNXI_AMP
	tristate "sunxi amp msgbox driver"
	select RPMSG
	default n
	help
	  Say y here to enable support for the sunxi msgbox communication driver.

config RPMSG_DSP_STANDBY
	tristate "support send dsp standby msg when suspend."
	select RPMSG_SUNXI_AMP
	default n
	help
	  Say y here to enable support dsp standby communication driver
	  and make dsp standby when suspend.


config RPMSG_QCOM_GLINK_SMEM
	tristate "Qualcomm SMEM Glink driver"
	select RPMSG_QCOM_GLINK_NATIVE
	depends on MAILBOX
	depends on QCOM_SMEM
	help
	  Say y here to enable support for the GLINK SMEM communication driver,
	  which provides support for using the GLINK communication protocol
	  over SMEM.

config RPMSG_QCOM_SMD
	tristate "Qualcomm Shared Memory Driver (SMD)"
	depends on MAILBOX
	depends on QCOM_SMEM
	select RPMSG
	help
	  Say y here to enable support for the Qualcomm Shared Memory Driver
	  providing communication channels to remote processors in Qualcomm
	  platforms.

config RPMSG_VIRTIO
	tristate "Virtio RPMSG bus driver"
	depends on HAS_DMA
	select RPMSG
	select VIRTIO

config RPMSG_NOTIFY
	tristate "Allwinner rpmsg notify driver"
	default n
	select RPMSG
	help
	  Say Y here to enable rpmsg notify driver. It provides notification
	  mechanism base on rpmsg.

config RPMSG_HEARTBEAT
	tristate "Allwinnertech RPMSG hearbeat driver"
	default n
	select RPMSG
	help
	  Say y here to enable support for the rpmsg hearbeat.

config RPMSG_SUNXI_TTY
	tristate "Allwinner RPMsg tty driver"
	select RPMSG
	help
	  Say y here to export rpmsg endpoints as tty console, usually found
	  in /dev/tty_rpmsg.
	  This makes it possible for user-space programs to send and receive
	  rpmsg messages as a standard tty protocol.

config RPMSG_SUNXI_CLIENT_SAMPLE
	tristate "Allwinner RPMsg client sample"
	select RPMSG
	select RPMSG_VIRTIO
	default n
	help
	  Say y here to enable support for the RPMsg client sample driver to
	  communicate with remote processors on allwinner platforms.

config RPMSG_CTRL
	tristate "sunxi rpmsg ctrl driver"
	default n
	select RPMSG
	help
	  Say Y here to export rpmsg ctrl device files, usually found in /dev.
	  They make it possible for user-space programs to create rpmsg
	  endpoints device, it can be found in /dev/rpmsg%d.

config RPMSG_OPENAMP_TEST
	tristate "Allwinner rpmsg openamp test driver"
	default n
	select RPMSG
	help
	  Say Y here to enable rpmsg openamp test driver. It provides notification
	  mechanism base on rpmsg.

endmenu
```
