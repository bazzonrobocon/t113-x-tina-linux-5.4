## modules/nand/common1/Kconfig
```kconfig
choice
	prompt "choice spinand or rawnand"
	depends on (SUNXI_NAND)

	config SUNXI_RAWNAND
		bool "sunxi raw nand driver"


	config	SUNXI_SPINAND
		bool "sunxi spi nand driver"

endchoice

config SUNXI_RAWNAND_CD
	bool "sunxi rawnand exteral module detect unclean poweroff"
	depends on SUNXI_RAWNAND
	help
	exteral module detect unclean poweroff(e.g. powerdown),then it send a
	signal to gpio,gpio generate signal to stop ndfc work.
	this should be support by hardware circuit.

	if you enable it, and you should configure property cd-debounce-delay-ms and
	pwroff-gpios in dts

	  WARNING: the gpio can't be used by other
```
